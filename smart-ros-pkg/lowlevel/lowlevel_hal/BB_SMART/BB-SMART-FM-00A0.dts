/dts-v1/;
/plugin/;

/ {
	compatible = "ti,beaglebone", "ti,beaglebone-black";

	/* identification */
	part-number = "BB-SMART-FM";
	version = "00A0";

	/* state the resources this cape uses */
	exclusive-use =
		/* the pin header uses */
		"P8.3",
		"P8.4",
		"P8.5",
		"P8.6",
		"P8.7",
		"P8.8",
		"P8.9",
		"P8.10",
		"P8.11",	/* pru0.r30.15		*/
		"P8.12",	/* pru0.r30.14		*/
		"P8.13",
		"P8.20",	/* pru1.r30.13		*/
		"P8.21",	/* pru1.r30.12		*/
		"P8.27",	/* pru1.r30.8	*/
		"P8.28",	/* pru1.r30.10		*/
		"P8.29",	/* pru1.r30.9	*/
		"P8.30",	/* pru1.r30.11		*/
		"P8.43",	/* pru1.r30.2	*/
		"P8.44",	/* pru1.r30.3		*/
		"P8.45",	/* pru1.r30.0		*/
	
		/* the hardware IP uses */
		"gpio1_6",
		"gpio1_7",
		"gpio1_2",
		"gpio1_3",
		"gpio2_2",
		"gpio2_3",
		"gpio2_5",
		"gpio2_4",
		"gpio1_13",
		"gpio1_12",
		"gpio0_23",
		"gpio1_31",
		"gpio1_30",
		"gpio2_0",
		"gpio2_24",
		"gpio2_22",
		"gpio2_25",
		"gpio2_10",
		"gpio2_9",
		"gpio2_8",
		"pru0";

	fragment@0 {
		target = <&am33xx_pinmux>;
		__overlay__ {

			foo_pins: foo_pins {
				pinctrl-single,pins = <
					0x18 0x3F
					0x1c 0x3F
					0x08 0x3F
					0x0c 0x3F
					0x90 0x3F
					0x94 0x3F
					0x9C 0x3F
					0x98 0x3F
					0x34 0x3F	/* p8.11 pru0.r30.15	*/
					0x30 0x3F	/* p8.12 pru0.r30.14	*/
					0x24 0x3F
					0x84 0x3F	/* p8.20 pru1.r30.13	*/
					0x80 0x3F	/* p8.21 pru1.r30.12	*/
					0xe0 0x3F	/* p8.27 pru1.r30.8 	*/
					0xe8 0x3F	/* p8.28 pru1.r30.10	*/
					0xe4 0x3F	/* p8.29 pru1.r30.9	*/
					0xec 0x3F	/* p8.30 pru1.r30.11	*/
					0xa8 0x3F	/* p8.43 pru1.r30.2	*/
					0xac 0x3F	/* p8.44 pru1.r30.3	*/
					0xa0 0x3F	/* p8.45 pru1.r30.0	*/
				>;
			};
		};
	};

	fragment@1 {
		target = <&pruss>;
		__overlay__ {
			status = "okay";

			pinctrl-names = "default";
			pinctrl-0 = <&foo_pins>;

		};
	};
};

